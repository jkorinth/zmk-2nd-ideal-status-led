## Kconfig
```kconfig
menuconfig ZMK_2NDIDEAL_STATUS_LED
	bool "Custom status LED (takes over RGB underglow)"
	select LED_STRIP
	default n

if ZMK_2NDIDEAL_STATUS_LED

config ZMK_RGB_UNDERGLOW
	default n

config ZMK_2NDIDEAL_STATUS_LED_BRIGHTNESS
	int "Single channel brightness (0-255)"
	default 32

config ZMK_2NDIDEAL_STATUS_LED_TEST
	bool "Run WS2812B pixel test walk on boot"
	default n

config ZMK_2NDIDEAL_STATUS_LED_TEST_DELAY_MS
	int "Delay between test-walk steps (ms)"
	default 150
	depends on ZMK_2NDIDEAL_STATUS_LED_TEST

config ZMK_2NDIDEAL_STATUS_LED_TEST_RAINBOW
	bool "Run rainbow hue-shift on boot instead of the fade walk"
	default n
	depends on ZMK_2NDIDEAL_STATUS_LED_TEST

config ZMK_2NDIDEAL_STATUS_LED_TEST_NO_BLE
	bool "Diagnostic: bt_disable() on boot to silence the radio during LED tests"
	default n
	depends on ZMK_2NDIDEAL_STATUS_LED_TEST
	help
	  Kills the BLE radio (no advertising, no connections, no split link)
	  right after boot so an LED test thread runs with zero radio
	  activity. Breaks split/host connectivity — only useful for A/B
	  testing whether WS2812 glitches correlate with BLE activity.

config ZMK_2NDIDEAL_BL_RESET
	bool "One-shot: reset stored per-LED backlight colors to defaults on next boot"
	default n
	help
	  Enable this, build, and flash once to discard whatever is currently
	  persisted under settings key "bl/leds" and rewrite it with the
	  compiled-in defaults. Disable this and reflash again afterward —
	  leaving it enabled resets the stored colors back to defaults on
	  every boot.

endif # ZMK_2NDIDEAL_STATUS_LED

config ZMK_BEHAVIOR_STATUS_LED
	bool
	default y
	depends on DT_HAS_ZMK_BEHAVIOR_STATUS_LED_ENABLED

if ZMK_BEHAVIOR_STATUS_LED
endif #ZMK_BEHAVIOR_STATUS_LED

config ZMK_BEHAVIOR_BL_SELECT
	bool
	default y
	depends on DT_HAS_ZMK_BEHAVIOR_BL_SELECT_ENABLED

config ZMK_BEHAVIOR_BL_ADJUST
	bool
	default y
	depends on DT_HAS_ZMK_BEHAVIOR_BL_ADJUST_ENABLED

config ZMK_BEHAVIOR_BL_COMMIT
	bool
	default y
	depends on DT_HAS_ZMK_BEHAVIOR_BL_COMMIT_ENABLED
```

## dts/bindings/behaviors/zmk,behavior-bl-adjust.yaml
```yaml
# Copyright (c) 2026 Jens Korinth
# SPDX-License-Identifier: GPLv2+
description: Adjust one HSB component of the currently-selected underglow LED
compatible: "zmk,behavior-bl-adjust"
include: two_param.yaml
```

## dts/bindings/behaviors/zmk,behavior-bl-commit.yaml
```yaml
# Copyright (c) 2026 Jens Korinth
# SPDX-License-Identifier: GPLv2+
description: Commit or discard the in-progress underglow LED edit
compatible: "zmk,behavior-bl-commit"
include: one_param.yaml
```

## dts/bindings/behaviors/zmk,behavior-bl-select.yaml
```yaml
# Copyright (c) 2026 Jens Korinth
# SPDX-License-Identifier: GPLv2+
description: Select which underglow LED to edit on the 2nd Ideal shield
compatible: "zmk,behavior-bl-select"
include: one_param.yaml
```

## dts/bindings/behaviors/zmk,behavior-status-led.yaml
```yaml
# Copyright (c) 2026 Jens Korinth
# SPDX-License-Identifier: GPLv2+
description: Lighting control for the 2nd Ideal shield
compatible: "zmk,behavior-status-led"
include: one_param.yaml
```
